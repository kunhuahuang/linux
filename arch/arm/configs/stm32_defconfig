## arch/arm/configs/stm32_defconfig
```kconfig
CONFIG_LOG_BUF_SHIFT=12
CONFIG_CC_OPTIMIZE_FOR_SIZE=y
CONFIG_EMBEDDED=y
# CONFIG_MMU is not set
CONFIG_ARCH_STM32=y
CONFIG_XIP_KERNEL=y
CONFIG_XIP_PHYS_ADDR=0x08020000
```
